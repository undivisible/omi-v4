## sysbuild.conf
```
#
# Copyright (c) 2024 Nordic Semiconductor ASA
#
# SPDX-License-Identifier: LicenseRef-Nordic-5-Clause
#

SB_CONFIG_WIFI_NRF70=y
SB_CONFIG_WIFI_NRF70_SCAN_ONLY=y

SB_CONFIG_PARTITION_MANAGER=y
SB_CONFIG_BOOTLOADER_MCUBOOT=y
SB_CONFIG_BOOT_SIGNATURE_KEY_FILE="${APP_DIR}/../bootloader/mcuboot/root-rsa-2048.pem"

# Dual Cores Boot
SB_CONFIG_PM_OVERRIDE_EXTERNAL_DRIVER_CHECK=y
SB_CONFIG_PM_EXTERNAL_FLASH_MCUBOOT_SECONDARY=y
SB_CONFIG_SECURE_BOOT_NETCORE=y
SB_CONFIG_MCUBOOT_UPDATEABLE_IMAGES=2
SB_CONFIG_MCUBOOT_NRF53_MULTI_IMAGE_UPDATE=y
SB_CONFIG_NETCORE_APP_UPDATE=y
SB_CONFIG_MCUBOOT_MODE_OVERWRITE_ONLY=y
```

## prj.conf
```kconfig
CONFIG_SERIAL=y
CONFIG_CONSOLE=y
CONFIG_UART_CONSOLE=y
CONFIG_SHELL_BACKEND_SERIAL=y
CONFIG_SHELL_AUTOSTART=n

CONFIG_GPIO=y
CONFIG_INPUT=y
CONFIG_I2C=y
CONFIG_I2C_SHELL=y
CONFIG_SPI=y
# CONFIG_SPI_NOR=y
CONFIG_SPI_SHELL=y

CONFIG_PM_DEVICE=y
# CONFIG_PM_DEVICE_RUNTIME=y
CONFIG_ADC=y
CONFIG_ADC_ASYNC=y
CONFIG_ADC_NRFX_SAADC=y
CONFIG_AUDIO=y
CONFIG_AUDIO_DMIC=y
CONFIG_FLASH=y
CONFIG_FLASH_JESD216_API=y
CONFIG_DISK_DRIVER_SDMMC=y
CONFIG_SENSOR=y
CONFIG_LSM6DSL=y
CONFIG_LSM6DSL_TRIGGER_NONE=y
CONFIG_REGULATOR=y
CONFIG_ENTROPY_GENERATOR=y

CONFIG_HEAP_MEM_POOL_SIZE=30000

CONFIG_BT=y
CONFIG_BT_SMP=y
CONFIG_BT_PERIPHERAL=y
CONFIG_BT_DIS=y
CONFIG_BT_DIS_PNP=n
CONFIG_BT_BAS=y
CONFIG_BT_DEVICE_NAME="Omi EVT"
CONFIG_BT_DIS_MODEL="Omi EVT"
CONFIG_BT_DIS_MANUF="Based Hardware"
CONFIG_BT_DIS_FW_REV_STR="0.0.9"
CONFIG_BT_DIS_HW_REV_STR="5.0"
CONFIG_BT_DEVICE_APPEARANCE=768
CONFIG_CBPRINTF_FP_SUPPORT=y
CONFIG_BT_SHELL=y
CONFIG_BT_OBSERVER=y
CONFIG_BT_GATT_DYNAMIC_DB=y
CONFIG_BT_DIS_FW_REV=y
CONFIG_BT_DIS_HW_REV=y

CONFIG_NCS_SAMPLE_MCUMGR_BT_OTA_DFU=y
CONFIG_MCUMGR_GRP_IMG_ALLOW_ERASE_PENDING=y
# Enable the BT NUS shell
CONFIG_SHELL=y
CONFIG_SHELL_BT_NUS=y
CONFIG_SHELL_BT_NUS_LOG_LEVEL_DBG=y
CONFIG_SHELL_BACKEND_DUMMY=y

CONFIG_POWEROFF=y

# CONFIG_T5838_LOG_LEVEL_DBG=y
# CONFIG_T5838_AAD_TRIGGER=y

# file system
# CONFIG_MAIN_STACK_SIZE=2048
CONFIG_FILE_SYSTEM=y
CONFIG_FILE_SYSTEM_EXT2=y

# Enable to allow formatting
CONFIG_FILE_SYSTEM_MKFS=y
# CONFIG_TEST_RANDOM_GENERATOR=y

CONFIG_DISK_ACCESS=y
CONFIG_DISK_DRIVER_SDMMC=y

# First block of first partition after GPT
CONFIG_EXT2_DISK_STARTING_SECTOR=2082

# wifi
CONFIG_EARLY_CONSOLE=y

CONFIG_NETWORKING=y
CONFIG_TEST_RANDOM_GENERATOR=y

CONFIG_MAIN_STACK_SIZE=8192
CONFIG_SHELL_STACK_SIZE=5200
CONFIG_SYSTEM_WORKQUEUE_STACK_SIZE=4096
CONFIG_NET_TX_STACK_SIZE=2048
CONFIG_NET_RX_STACK_SIZE=2048

CONFIG_NET_PKT_RX_COUNT=10
CONFIG_NET_PKT_TX_COUNT=10
CONFIG_NET_BUF_RX_COUNT=20
CONFIG_NET_BUF_TX_COUNT=20
CONFIG_NET_MAX_CONTEXTS=10
CONFIG_NET_DHCPV4=y

CONFIG_NET_IPV4=y
CONFIG_NET_IPV6=n

CONFIG_NET_TCP=y

CONFIG_INIT_STACKS=y

CONFIG_NET_SHELL=y

CONFIG_NET_STATISTICS=y
CONFIG_NET_STATISTICS_PERIODIC_OUTPUT=n

CONFIG_WIFI=y
CONFIG_WIFI_NRF70=y
CONFIG_NET_L2_WIFI_SHELL=y
CONFIG_NRF_WIFI_LOW_POWER=y

CONFIG_MBEDTLS=y
CONFIG_MBEDTLS_ENABLE_HEAP=y
CONFIG_MBEDTLS_HEAP_SIZE=70000

# printing of scan results puts pressure on queues in new locking
# design in net_mgmt. So, use a higher timeout for a crowded
# environment.
CONFIG_NET_MGMT_EVENT_QUEUE_TIMEOUT=5000
CONFIG_NET_MGMT_EVENT_QUEUE_SIZE=16

CONFIG_WIFI_FIXED_MAC_ADDRESS="14:5A:FC:5E:37:9C"

# open app log
CONFIG_LOG=y
# CONFIG_NET_LOG=y
# CONFIG_LOG_DEFAULT_LEVEL=3 
# CONFIG_LOG_MODE_IMMEDIATE=y
# CONFIG_SENSOR_LOG_LEVEL_DBG=y
# CONFIG_FLASH_LOG_LEVEL_DBG=y
# CONFIG_FS_LOG_LEVEL_DBG=y
# CONFIG_WIFI_LOG_LEVEL_ERR=y
# CONFIG_WIFI_NRF70_LOG_LEVEL_DBG=y
#
CONFIG_PWM=y
```

## app.overlay
```dts
//&uart0 {
// 	current-speed = <115200>;
//};
// Override lsm6dso to use lsm6dsl driver (LSM6DS3TR-C has WHO_AM_I = 0x6A)
// Need to delete accel-pm and gyro-pm properties which are LSM6DSO-specific
&lsm6ds3tr_c {
	compatible = "st,lsm6dsl";
	/delete-property/ accel-pm;
	/delete-property/ gyro-pm;
	status = "okay";
};
```

## src/main.c
```c
#include <zephyr/drivers/gpio.h>
#include <zephyr/dt-bindings/gpio/nordic-nrf-gpio.h>
#include <zephyr/kernel.h>
#include <zephyr/pm/device_runtime.h>
#include <zephyr/shell/shell.h>
#include <zephyr/shell/shell_uart.h>

#include "battery.h"
#include "button.h"
#include "mic.h"
#include "sd.h"
#include "spi_flash.h"

static const struct device *const buttons = DEVICE_DT_GET(DT_ALIAS(buttons));
static const struct gpio_dt_spec rfsw_en = GPIO_DT_SPEC_GET_OR(DT_NODELABEL(rfsw_en_pin), gpios, {0});
static int init_module(void)
{
    int ret;
    ret = mic_init();
    if (ret < 0) {
        printk("Failed to initialize mic module (%d)\n", ret);
    }

    ret = flash_init();
    if (ret < 0) {
        printk("Failed to initialize flash module (%d)\n", ret);
    }

    ret = app_sd_init();
    if (ret < 0) {
        printk("Failed to initialize sd module (%d)\n", ret);
    }

    ret = bat_init();
    if (ret < 0) {
        printk("Failed to initialize battery module (%d)\n", ret);
    }

    gpio_pin_configure_dt(&rfsw_en, (GPIO_OUTPUT | NRF_GPIO_DRIVE_S0H1));
    gpio_pin_set_dt(&rfsw_en, 1);
    return 0;
}

int main(void)
{
    struct input_event evt;
    int ret;
    bool button_pressed = false;
    if (init_module() < 0) {
        printk("Failed to initialize modules\n");
        return -1;
    }

    // Start shell over UART
    const struct shell *shell_ptr = shell_backend_uart_get_ptr();
    if (shell_ptr) {
        ret = shell_start(shell_ptr);
        if (ret < 0) {
            printk("Failed to start shell (%d)\n", ret);
        }
    } else {
        printk("UART shell backend not found.\n");
    }

    printk("Starting omi EVT test...\n");

    ret = pm_device_runtime_get(buttons);
    if (ret < 0) {
        printk("Failed to get device (%d)", ret);
        shell_execute_cmd(NULL, "sys off");
        return 0;
    }

    k_msgq_purge(&input_button);

    while (1) {

        ret = k_msgq_get(&input_button, &evt, K_SECONDS(60));
        if (ret == -EAGAIN) {
            // if (!button_pressed && !is_charging)
            // 	shell_execute_cmd(NULL, "sys off");
            continue;
        }

        switch (evt.code) {
        case INPUT_KEY_ENTER:
            if (evt.value == 1) {
                printk("usr button pressed");
                shell_execute_cmd(NULL, "motor on");
                shell_execute_cmd(NULL, "led on 0");
                // shell_execute_cmd(NULL, "led on 1");
                shell_execute_cmd(NULL, "led on 2");
                button_pressed = true;
            } else {
                printk("usr button released");
                shell_execute_cmd(NULL, "motor off");
                shell_execute_cmd(NULL, "led off 0");
                // shell_execute_cmd(NULL, "led off 1");
                shell_execute_cmd(NULL, "led off 2");
                button_pressed = false;
            }
            break;
        }
    }

    ret = pm_device_runtime_put(buttons);
    if (ret < 0) {
        printk("Failed to put device (%d)", ret);
        shell_execute_cmd(NULL, "sys off");
        return 0;
    }

    shell_execute_cmd(NULL, "sys off");
    return 0;
}
```

## src/ble.c
```c
#include <bluetooth/services/nus.h>
#include <shell/shell_bt_nus.h>
#include <stdio.h>
#include <zephyr/bluetooth/bluetooth.h>
#include <zephyr/bluetooth/gatt.h>
#include <zephyr/bluetooth/hci.h>
#include <zephyr/bluetooth/uuid.h>
#include <zephyr/kernel.h>
#include <zephyr/logging/log.h>
#include <zephyr/shell/shell.h>

LOG_MODULE_REGISTER(ble_shell);

#define BT_UUID_OMI_VAL BT_UUID_128_ENCODE(0x19b10000, 0xe8f2, 0x537e, 0x4f6c, 0xd104768a1214)

#define DEVICE_NAME CONFIG_BT_DEVICE_NAME
#define DEVICE_NAME_LEN (sizeof(DEVICE_NAME) - 1)

struct bt_conn *current_conn;

static const struct bt_data ad[] = {
    BT_DATA_BYTES(BT_DATA_FLAGS, (BT_LE_AD_GENERAL | BT_LE_AD_NO_BREDR)),
    BT_DATA(BT_DATA_NAME_COMPLETE, DEVICE_NAME, DEVICE_NAME_LEN),
};

static const struct bt_data sd[] = {
    BT_DATA_BYTES(BT_DATA_UUID128_ALL, BT_UUID_OMI_VAL),
};

static void connected(struct bt_conn *conn, uint8_t err)
{
    if (err) {
        LOG_ERR("Connection failed, err 0x%02x %s", err, bt_hci_err_to_str(err));
        return;
    }

    LOG_INF("Connected");
    current_conn = bt_conn_ref(conn);
    shell_bt_nus_enable(conn);
}

static void disconnected(struct bt_conn *conn, uint8_t reason)
{
    LOG_INF("Disconnected, reason 0x%02x %s", reason, bt_hci_err_to_str(reason));

    shell_bt_nus_disable();
    if (current_conn) {
        bt_conn_unref(current_conn);
        current_conn = NULL;
    }
}

static char *log_addr(struct bt_conn *conn)
{
    static char addr[BT_ADDR_LE_STR_LEN];

    bt_addr_le_to_str(bt_conn_get_dst(conn), addr, sizeof(addr));

    return addr;
}

static void __attribute__((unused))
security_changed(struct bt_conn *conn, bt_security_t level, enum bt_security_err err)
{
    char *addr = log_addr(conn);

    if (!err) {
        LOG_INF("Security changed: %s level %u", addr, level);
    } else {
        LOG_INF("Security failed: %s level %u err %d %s", addr, level, err, bt_security_err_to_str(err));
    }
}

BT_CONN_CB_DEFINE(conn_callbacks) = {.connected = connected,
                                     .disconnected = disconnected,
                                     COND_CODE_1(CONFIG_BT_SMP, (.security_changed = security_changed), ())};

static void auth_passkey_display(struct bt_conn *conn, unsigned int passkey)
{
    LOG_INF("Passkey for %s: %06u", log_addr(conn), passkey);
}

static void auth_cancel(struct bt_conn *conn)
{
    LOG_INF("Pairing cancelled: %s", log_addr(conn));
}

static void pairing_complete(struct bt_conn *conn, bool bonded)
{
    LOG_INF("Pairing completed: %s, bonded: %d", log_addr(conn), bonded);
}

static void pairing_failed(struct bt_conn *conn, enum bt_security_err reason)
{
    LOG_INF("Pairing failed conn: %s, reason %d %s", log_addr(conn), reason, bt_security_err_to_str(reason));
}

static struct bt_conn_auth_cb conn_auth_callbacks = {
    .passkey_display = auth_passkey_display,
    .cancel = auth_cancel,
};

static struct bt_conn_auth_info_cb conn_auth_info_callbacks = {.pairing_complete = pairing_complete,
                                                               .pairing_failed = pairing_failed};

static int cmd_ble_on(void)
{
    int err;

    printk("Starting Bluetooth NUS shell transport example\n");

    if (IS_ENABLED(CONFIG_BT_SMP)) {
        err = bt_conn_auth_cb_register(&conn_auth_callbacks);
        if (err) {
            printk("Failed to register authorization callbacks.\n");
            return 0;
        }

        err = bt_conn_auth_info_cb_register(&conn_auth_info_callbacks);
        if (err) {
            printk("Failed to register authorization info callbacks.\n");
            return 0;
        }
    }

    err = bt_enable(NULL);
    if (err) {
        LOG_ERR("BLE enable failed (err: %d)", err);
        return 0;
    }

    err = shell_bt_nus_init();
    if (err) {
        LOG_ERR("Failed to initialize BT NUS shell (err: %d)", err);
        return 0;
    }

    err = bt_le_adv_start(BT_LE_ADV_CONN_FAST_2, ad, ARRAY_SIZE(ad), sd, ARRAY_SIZE(sd));
    if (err) {
        LOG_ERR("Advertising failed to start (err %d)", err);
        return 0;
    }

    LOG_INF("Bluetooth ready. Advertising started.");

    return 0;
}

static int cmd_ble_off(void)
{
    int err;
    // unregister authorization callbacks
    if (IS_ENABLED(CONFIG_BT_SMP)) {
        bt_conn_auth_cb_register(NULL);
        bt_conn_auth_info_cb_unregister(&conn_auth_info_callbacks);
    }
    err = bt_disable();
    if (err < 0) {
        printk("Bluetooth disable failed (%d)", err);
        return err;
    }
    printk("Bluetooth disabled");
    return 0;
}

SHELL_STATIC_SUBCMD_SET_CREATE(sub_ble_cmds,
                               SHELL_CMD(on, NULL, "Turn on BLE", cmd_ble_on),
                               SHELL_CMD(off, NULL, "Turn off BLE", cmd_ble_off),
                               SHELL_SUBCMD_SET_END);

SHELL_CMD_REGISTER(ble, &sub_ble_cmds, "BLE control commands", NULL);
```

## src/ble_throughput_test.c
```c
#include <stdint.h>
#include <zephyr/bluetooth/bluetooth.h>
#include <zephyr/bluetooth/gatt.h>
#include <zephyr/bluetooth/uuid.h>
#include <zephyr/kernel.h>
#include <zephyr/logging/log.h>
#include <zephyr/sys/atomic.h> // Include for atomic operations
#include <zephyr/sys/ring_buffer.h>
#include <zephyr/timing/timing.h> // Include for timing

LOG_MODULE_REGISTER(transport_ble_test, CONFIG_LOG_DEFAULT_LEVEL);

#define TEST_PACKET_SIZE 50
#define WRITE_INTERVAL_MS 10
#define TEST_RING_BUF_SIZE (TEST_PACKET_SIZE * 150) // Store 100 packets
#define WRITER_STACK_SIZE 1024 * 10
#define READER_STACK_SIZE 2048 * 10
#define WRITER_PRIORITY K_PRIO_PREEMPT(7)
#define READER_PRIORITY K_PRIO_PREEMPT(6)

// --- Test-specific Globals ---
static struct ring_buf test_ring_buf;
static uint8_t test_tx_queue[TEST_RING_BUF_SIZE];
static struct bt_conn *test_conn = NULL;
static volatile bool test_subscribed = false;
static atomic_t test_write_count = ATOMIC_INIT(0);
static atomic_t test_gatt_notify_count = ATOMIC_INIT(0);
static atomic_t test_write_failed_count = ATOMIC_INIT(0);
static atomic_t test_notify_failed_count = ATOMIC_INIT(0);

K_THREAD_STACK_DEFINE(writer_stack_area, WRITER_STACK_SIZE);
static struct k_thread writer_thread_data;

K_THREAD_STACK_DEFINE(reader_stack_area, READER_STACK_SIZE);
static struct k_thread reader_thread_data;

#define LOGGER_STACK_SIZE 1024
#define LOGGER_PRIORITY K_PRIO_PREEMPT(8) // Lower priority than reader/writer
K_THREAD_STACK_DEFINE(logger_stack_area, LOGGER_STACK_SIZE);
static struct k_thread logger_thread_data;

// --- Test-specific BLE Definitions ---

// Use the same UUIDs as transport.c for compatibility with clients
static struct bt_uuid_128 test_audio_service_uuid =
    BT_UUID_INIT_128(BT_UUID_128_ENCODE(0x19B10000, 0xE8F2, 0x537E, 0x4F6C, 0xD104768A1214));
static struct bt_uuid_128 test_audio_characteristic_data_uuid =
    BT_UUID_INIT_128(BT_UUID_128_ENCODE(0x19B10001, 0xE8F2, 0x537E, 0x4F6C, 0xD104768A1214));

static void test_audio_ccc_cfg_changed(const struct bt_gatt_attr *attr, uint16_t value)
{
    test_subscribed = (value == BT_GATT_CCC_NOTIFY);
    LOG_INF("Client %s", test_subscribed ? "subscribed" : "unsubscribed");
}

// Minimal GATT service definition for the test
static struct bt_gatt_attr test_audio_service_attrs[] = {
    BT_GATT_PRIMARY_SERVICE(&test_audio_service_uuid),
    BT_GATT_CHARACTERISTIC(&test_audio_characteristic_data_uuid.uuid,
                           BT_GATT_CHRC_NOTIFY,
                           BT_GATT_PERM_READ,
                           NULL,
                           NULL,
                           NULL),
    BT_GATT_CCC(test_audio_ccc_cfg_changed, BT_GATT_PERM_READ | BT_GATT_PERM_WRITE),
};

static struct bt_gatt_service test_audio_service = BT_GATT_SERVICE(test_audio_service_attrs);

// Minimal Advertisement data
static const struct bt_data test_ad[] = {
    BT_DATA_BYTES(BT_DATA_FLAGS, (BT_LE_AD_GENERAL | BT_LE_AD_NO_BREDR)),
    BT_DATA(BT_DATA_UUID128_ALL, test_audio_service_uuid.val, sizeof(test_audio_service_uuid.val)),
    BT_DATA(BT_DATA_NAME_COMPLETE, "OMI-BLE-TEST", sizeof("OMI-BLE-TEST") - 1),
};

// --- Test-specific Connection Callbacks ---

static void test_connected(struct bt_conn *conn, uint8_t err)
{
    if (err) {
        LOG_ERR("Connection failed (err 0x%02x)", err);
        if (test_conn) {
            bt_conn_unref(test_conn);
            test_conn = NULL;
        }
        test_subscribed = false;
    } else {
        LOG_INF("Connected");
        test_conn = bt_conn_ref(conn);
        test_subscribed = false; // Require subscription after connection
    }
}

static void test_disconnected(struct bt_conn *conn, uint8_t reason)
{
    LOG_INF("Disconnected (reason 0x%02x)", reason);
    if (test_conn == conn) {
        bt_conn_unref(test_conn);
        test_conn = NULL;
        test_subscribed = false;
    }
}

static struct bt_conn_cb test_conn_callbacks = {
    .connected = test_connected,
    .disconnected = test_disconnected,
};

// --- Test Threads ---

static void writer_thread_entry(void *p1, void *p2, void *p3)
{
    uint8_t dummy_data[TEST_PACKET_SIZE];
    uint8_t counter = 0;

    // Fill with initial pattern
    for (int i = 0; i < TEST_PACKET_SIZE; i++) {
        dummy_data[i] = i;
    }

    LOG_INF("Writer thread started");

    while (1) {
        k_msleep(WRITE_INTERVAL_MS);

        // Modify data slightly each time
        dummy_data[0] = counter++;

        int written = ring_buf_put(&test_ring_buf, dummy_data, TEST_PACKET_SIZE);
        if (written != TEST_PACKET_SIZE) {
            // LOG_WRN("Ring buffer full, discarding data!");
            atomic_inc(&test_write_failed_count); // Increment write failed counter
            // Optional: Add a small sleep here if buffer is often full
        } else {
            atomic_inc(&test_write_count); // Increment write counter on success
        }
    }
}

static void reader_notifier_thread_entry(void *p1, void *p2, void *p3)
{
    uint8_t data_buffer[TEST_PACKET_SIZE];
    int err;

    LOG_INF("Reader/Notifier thread started");

    while (1) {
        // Wait until connected and subscribed
        while (!test_conn || !test_subscribed) {
            k_msleep(100); // Check periodically
        }

        // Read data from ring buffer
        int read = ring_buf_get(&test_ring_buf, data_buffer, TEST_PACKET_SIZE);

        if (read == TEST_PACKET_SIZE) {
            // Send notification
            err = bt_gatt_notify(test_conn, &test_audio_service.attrs[1], data_buffer, TEST_PACKET_SIZE);
            if (err == -EAGAIN || err == -ENOMEM) {
                // Queue is full, retry after a short delay
                LOG_WRN("bt_gatt_notify failed (%d), retrying...", err);
                // Put data back into ring buffer (might fail if buffer became full)
                if (ring_buf_put(&test_ring_buf, data_buffer, TEST_PACKET_SIZE) != TEST_PACKET_SIZE) {
                    LOG_ERR("Failed to put data back into ring buffer after notify failure!");
                }
                k_msleep(5); // Small delay before retrying
                continue;    // Skip yield at the end, try again immediately
            } else if (err) {
                LOG_ERR("bt_gatt_notify failed unexpectedly (err %d)", err);
                atomic_inc(&test_notify_failed_count); // Increment notify failed counter
                // Consider what to do on other errors - maybe stop test?
                // For now, just log and continue trying.
            } else {
                // LOG_DBG("Sent %d bytes", TEST_PACKET_SIZE);
                atomic_inc(&test_gatt_notify_count); // Increment notify counter on success
            }
        } else if (read == 0) {
            // Buffer is empty, wait a bit
            k_msleep(5);
        } else {
            // Should not happen if writes are always TEST_PACKET_SIZE
            LOG_ERR("Ring buffer read unexpected size: %d", read);
        }

        // Yield to other threads
        k_yield();
    }
}

// --- Logger Thread ---

static void logger_thread_entry(void *p1, void *p2, void *p3)
{
    uint32_t last_write_count = 0;
    uint32_t last_notify_count = 0;
    uint32_t current_write_count;
    uint32_t current_notify_count;
    uint32_t write_rate;
    uint32_t notify_rate;
    uint32_t last_write_failed_count = 0;
    uint32_t last_notify_failed_count = 0;
    uint32_t current_write_failed_count;
    uint32_t current_notify_failed_count;
    uint32_t write_failed_rate;
    uint32_t notify_failed_rate;
    int64_t last_time = k_uptime_get();
    int64_t current_time;
    int64_t delta_time;

    LOG_INF("Logger thread started");

    while (1) {
        k_msleep(1000); // Log every second

        current_time = k_uptime_get();
        delta_time = current_time - last_time;

        if (delta_time <= 0) {
            // Avoid division by zero or negative time delta if clock wraps or resolution is low
            continue;
        }

        current_write_count = atomic_get(&test_write_count);
        current_notify_count = atomic_get(&test_gatt_notify_count);

        current_write_failed_count = atomic_get(&test_write_failed_count);
        current_notify_failed_count = atomic_get(&test_notify_failed_count);

        // Calculate rate per second
        write_rate = ((current_write_count - last_write_count) * 1000) / delta_time;
        notify_rate = ((current_notify_count - last_notify_count) * 1000) / delta_time;
        write_failed_rate = ((current_write_failed_count - last_write_failed_count) * 1000) / delta_time;
        notify_failed_rate = ((current_notify_failed_count - last_notify_failed_count) * 1000) / delta_time;

        LOG_INF("BLE Test Rate -> Writes/s: %u (Fail: %u), Notifies/s: %u (Fail: %u)",
                write_rate,
                write_failed_rate,
                notify_rate,
                notify_failed_rate);

        last_write_count = current_write_count;
        last_notify_count = current_notify_count;
        last_write_failed_count = current_write_failed_count;
        last_notify_failed_count = current_notify_failed_count;
        last_time = current_time;
    }
}

// --- Main Test Function ---

int transport_ble_test(void)
{
    int err;

    LOG_INF("Starting BLE Transport Test...");

    // 0. Initialize test state
    test_conn = NULL;
    test_subscribed = false;
    atomic_set(&test_write_count, 0); // Ensure counters start at 0
    atomic_set(&test_gatt_notify_count, 0);
    atomic_set(&test_write_failed_count, 0);
    atomic_set(&test_notify_failed_count, 0);
    ring_buf_init(&test_ring_buf, sizeof(test_tx_queue), test_tx_queue);

    // 1. Turn Bluetooth On
    err = bt_enable(NULL);
    if (err) {
        LOG_ERR("Bluetooth init failed (err %d)", err);
        return err;
    }
    LOG_INF("Bluetooth initialized");

    bt_conn_cb_register(&test_conn_callbacks);

    // 2. Register GATT Service
    err = bt_gatt_service_register(&test_audio_service);
    if (err) {
        LOG_ERR("Failed to register test GATT service (err %d)", err);
        return err;
    }
    LOG_INF("Test GATT service registered");

    // 3. Advertise
    err = bt_le_adv_start(BT_LE_ADV_CONN_FAST_2, test_ad, ARRAY_SIZE(test_ad), NULL, 0);
    if (err) {
        LOG_ERR("Advertising failed to start (err %d)", err);
        return err;
    }
    LOG_INF("Advertising successfully started. Waiting for connection and subscription...");

    // 4. Wait for subscriber (handled within reader thread)
    //    The reader thread will wait until test_conn and test_subscribed are set.

    // 5. Start Threads
    // Writer Thread
    k_tid_t writer_tid = k_thread_create(&writer_thread_data,
                                         writer_stack_area,
                                         K_THREAD_STACK_SIZEOF(writer_stack_area),
                                         writer_thread_entry,
                                         NULL,
                                         NULL,
                                         NULL,
                                         WRITER_PRIORITY,
                                         0,
                                         K_NO_WAIT);
    if (!writer_tid) {
        LOG_ERR("Failed to create writer thread");
        return -1; // Or appropriate error code
    }
    k_thread_name_set(writer_tid, "ble_test_writer");

    // Reader/Notifier Thread
    k_tid_t reader_tid = k_thread_create(&reader_thread_data,
                                         reader_stack_area,
                                         K_THREAD_STACK_SIZEOF(reader_stack_area),
                                         reader_notifier_thread_entry,
                                         NULL,
                                         NULL,
                                         NULL,
                                         READER_PRIORITY,
                                         0,
                                         K_NO_WAIT);
    if (!reader_tid) {
        LOG_ERR("Failed to create reader thread");
        // Consider stopping the writer thread here
        return -1; // Or appropriate error code
    }
    k_thread_name_set(reader_tid, "ble_test_reader");

    // Logger Thread
    k_tid_t logger_tid = k_thread_create(&logger_thread_data,
                                         logger_stack_area,
                                         K_THREAD_STACK_SIZEOF(logger_stack_area),
                                         logger_thread_entry,
                                         NULL,
                                         NULL,
                                         NULL,
                                         LOGGER_PRIORITY,
                                         0,
                                         K_NO_WAIT);
    if (!logger_tid) {
        LOG_ERR("Failed to create logger thread");
        // Consider stopping other threads here
        return -1; // Or appropriate error code
    }
    k_thread_name_set(logger_tid, "ble_test_logger");

    LOG_INF("Test threads started. Running indefinitely.");

    // The function returns, but the threads continue running.
    // You might want to add a mechanism to stop the test later.
    return 0;
}
```

## src/imu.c
```c
#include <nrfx.h>
#include <zephyr/device.h>
#include <zephyr/drivers/gpio.h>
#include <zephyr/drivers/i2c.h>
#include <zephyr/drivers/sensor.h>
#include <zephyr/dt-bindings/gpio/nordic-nrf-gpio.h>
#include <zephyr/kernel.h>
#include <zephyr/logging/log.h>
#include <zephyr/shell/shell.h>

LOG_MODULE_REGISTER(IMU, CONFIG_SENSOR_LOG_LEVEL);

static const struct device *const i2c_lsm6dso = DEVICE_DT_GET(DT_NODELABEL(lsm6ds3tr_c));
static const struct gpio_dt_spec lsm6dso_en = GPIO_DT_SPEC_GET_OR(DT_NODELABEL(lsm6dso_en_pin), gpios, {0});

// LSM6DS3TR-C has WHO_AM_I = 0x6A, use lsm6dsl driver
static int cmd_imu_get(const struct shell *sh, size_t argc, char **argv)
{
    int ret;
    struct sensor_value accel_data[3];
    struct sensor_value gyro_data[3];
    struct sensor_value odr_attr;
    /* set accel/gyro sampling frequency to 12.5 Hz */
    sensor_value_from_double(&odr_attr, 12.5);

    if (!device_is_ready(i2c_lsm6dso)) {
        shell_error(sh, "Device not ready");
        return -ENODEV;
    }

    ret = sensor_attr_set(i2c_lsm6dso, SENSOR_CHAN_ACCEL_XYZ, SENSOR_ATTR_SAMPLING_FREQUENCY, &odr_attr);
    if (ret) {
        shell_error(sh, "Failed to set accel sampling frequency\n");
        return ret;
    }

    ret = sensor_attr_set(i2c_lsm6dso, SENSOR_CHAN_GYRO_XYZ, SENSOR_ATTR_SAMPLING_FREQUENCY, &odr_attr);
    if (ret) {
        shell_error(sh, "Failed to set gyro sampling frequency\n");
        return ret;
    }

    ret = sensor_sample_fetch(i2c_lsm6dso);
    if (ret) {
        shell_error(sh, "Failed to fetch sample\n");
        return ret;
    }

    ret = sensor_channel_get(i2c_lsm6dso, SENSOR_CHAN_ACCEL_XYZ, accel_data);
    if (ret) {
        shell_error(sh, "Failed to get accel data\n");
        return ret;
    }

    ret = sensor_channel_get(i2c_lsm6dso, SENSOR_CHAN_GYRO_XYZ, gyro_data);
    if (ret) {
        shell_error(sh, "Failed to get gyro data\n");
        return ret;
    }

    // gpio_pin_set_dt(&lsm6dso_en, 0);
    shell_print(sh,
                "accel data: %d.%06d, %d.%06d, %d.%06d",
                accel_data[0].val1,
                accel_data[0].val2,
                accel_data[1].val1,
                accel_data[1].val2,
                accel_data[2].val1,
                accel_data[2].val2);
    shell_print(sh,
                "gyro data: %d.%06d, %d.%06d, %d.%06d",
                gyro_data[0].val1,
                gyro_data[0].val2,
                gyro_data[1].val1,
                gyro_data[1].val2,
                gyro_data[2].val1,
                gyro_data[2].val2);
    return ret;
}

SHELL_STATIC_SUBCMD_SET_CREATE(sub_imu_cmds, SHELL_CMD(get, NULL, "Get IMU data", cmd_imu_get), SHELL_SUBCMD_SET_END);

SHELL_CMD_REGISTER(imu, &sub_imu_cmds, "Get IMU data", NULL);

// define a funsion to make imu power on
static int imu_poweron(void)
{
    int ret;

    if (!device_is_ready(lsm6dso_en.port)) {
        LOG_ERR("GPIO port not ready for lsm6dso_en");
        return -ENODEV;
    }

    LOG_INF("IMU power on");
    ret = gpio_pin_configure_dt(&lsm6dso_en, (GPIO_OUTPUT | NRF_GPIO_DRIVE_S0H1));
    if (ret < 0) {
        LOG_ERR("Failed to configure pin %d (err %d)", lsm6dso_en.pin, ret);
        return ret;
    }

    ret = gpio_pin_set_dt(&lsm6dso_en, 1);
    if (ret < 0) {
        LOG_ERR("Failed to set pin %d (err %d)", lsm6dso_en.pin, ret);
        return ret;
    }
    k_sleep(K_MSEC(50));

    return 0;
}

SYS_INIT(imu_poweron, POST_KERNEL, 89);
```

## src/mic.c
```c
#include <stdio.h>
#include <stdlib.h>
#include <zephyr/audio/dmic.h>
#include <zephyr/device.h>
#include <zephyr/drivers/gpio.h>
#include <zephyr/kernel.h>
#include <zephyr/shell/shell.h>
#include <zephyr/sys/util.h>

#include "mic.h"

#define BITS_PER_BYTE 8

#define SAMPLE_RATE_HZ 16000
#define SAMPLE_BITS 16
#define CHANNEL_COUNT 2
#define TIMEOUT_MS 2000
#define CAPTURE_MS 1000
#define BLOCK_SIZE ((SAMPLE_BITS / BITS_PER_BYTE) * (SAMPLE_RATE_HZ * CAPTURE_MS) / 1000) * CHANNEL_COUNT
#define BLOCK_COUNT 2

static const struct device *const dmic = DEVICE_DT_GET(DT_ALIAS(dmic0));
static const struct gpio_dt_spec mic_en = GPIO_DT_SPEC_GET_OR(DT_NODELABEL(pdm_en_pin), gpios, {0});
static const struct gpio_dt_spec mic_thsel = GPIO_DT_SPEC_GET_OR(DT_NODELABEL(pdm_thsel_pin), gpios, {0});
static const struct gpio_dt_spec mic_wake = GPIO_DT_SPEC_GET_OR(DT_NODELABEL(pdm_wake_pin), gpios, {0});

K_MEM_SLAB_DEFINE_STATIC(mem_slab, BLOCK_SIZE, BLOCK_COUNT, 4);

static struct pcm_stream_cfg stream = {
    .pcm_rate = SAMPLE_RATE_HZ,
    .pcm_width = SAMPLE_BITS,
    .block_size = BLOCK_SIZE,
    .mem_slab = &mem_slab,
};

static struct dmic_cfg cfg = {
    .io =
        {
            .min_pdm_clk_freq = 1000000,
            .max_pdm_clk_freq = 3500000,
            .min_pdm_clk_dc = 40,
            .max_pdm_clk_dc = 60,
        },
    .streams = &stream,
    .channel =
        {
            .req_num_streams = 1,
            .req_num_chan = CHANNEL_COUNT,
        },
};

static bool initialized;

static int cmd_mic_capture(const struct shell *sh, size_t argc, char **argv)
{
    int ret, time = 1;
    void *buffer = NULL;
    uint32_t size;

    if (argc > 1) {
        char *endptr;
        time = strtol(argv[1], &endptr, 10);
        if (*endptr != '\0' || time <= 0) {
            shell_error(sh, "Invalid time argument");
            return -EINVAL;
        }
        time *= (1000 / CAPTURE_MS);
    }

    if (!initialized) {
        shell_error(sh, "Microphone module not initialized");
        return -EPERM;
    }

    // Configure and enable microphone pins
    mic_power_on();

    shell_print(sh, "S");
    ret = dmic_configure(dmic, &cfg);
    if (ret < 0) {
        shell_error(sh, "Failed to configure DMIC(%d)", ret);
        goto cleanup;
    }

    for (int i = 0; i < time; i++) {
        ret = dmic_trigger(dmic, DMIC_TRIGGER_START);
        if (ret < 0) {
            shell_error(sh, "START trigger failed (%d)", ret);
            goto cleanup;
        }

        ret = dmic_read(dmic, 0, &buffer, &size, TIMEOUT_MS);
        if (ret < 0) {
            shell_error(sh, "DMIC read failed (%d)", ret);
            dmic_trigger(dmic, DMIC_TRIGGER_STOP);
            goto cleanup;
        }

        // Process captured data
        for (int j = 0; j < size / sizeof(int16_t); j++) {
            shell_print(sh, "%d", ((int16_t *) buffer)[j]);
        }

        k_mem_slab_free(&mem_slab, buffer);
        buffer = NULL;
        ret = dmic_trigger(dmic, DMIC_TRIGGER_STOP);
        if (ret < 0) {
            shell_error(sh, "STOP trigger failed (%d)", ret);
        }
    }

cleanup:
    if (buffer) {
        k_mem_slab_free(&mem_slab, buffer);
    }
    shell_print(sh, "E");
    mic_power_off();

    return ret;
}

SHELL_STATIC_SUBCMD_SET_CREATE(sub_mic_cmds,
                               SHELL_CMD(capture, NULL, "Capture microphone data", cmd_mic_capture),
                               SHELL_SUBCMD_SET_END);

SHELL_CMD_REGISTER(mic, &sub_mic_cmds, "Microphone", NULL);

int mic_power_off(void)
{
    gpio_pin_configure_dt(&mic_thsel, GPIO_OUTPUT);
    gpio_pin_set_dt(&mic_thsel, 0);
    gpio_pin_configure_dt(&mic_wake, GPIO_INPUT);
    gpio_pin_configure_dt(&mic_en, GPIO_OUTPUT);
    gpio_pin_set(mic_en.port, mic_en.pin, 0);
    return 0;
}

int mic_power_on(void)
{
    gpio_pin_configure_dt(&mic_thsel, GPIO_OUTPUT);
    gpio_pin_set_dt(&mic_thsel, 1);
    gpio_pin_configure_dt(&mic_wake, GPIO_INPUT);
    gpio_pin_configure_dt(&mic_en, GPIO_OUTPUT);
    gpio_pin_set_dt(&mic_en, 1);
    return 0;
}

int mic_init(void)
{
    if (!device_is_ready(dmic)) {
        return -ENODEV;
    }

    mic_power_off();

    cfg.channel.req_chan_map_lo =
        dmic_build_channel_map(0, 0, PDM_CHAN_LEFT) | dmic_build_channel_map(1, 0, PDM_CHAN_RIGHT);

    initialized = true;

    return 0;
}
```

## src/mic.h
```c
#ifndef APP_SRC_MIC_H_
#define APP_SRC_MIC_H_

int mic_init(void);

int mic_power_on(void);

int mic_power_off(void);

#endif /* APP_SRC_MIC_H_ */
```

## src/motor.c
```c
#include <zephyr/drivers/gpio.h>
#include <zephyr/kernel.h>
#include <zephyr/logging/log.h>
#include <zephyr/shell/shell.h>

static const struct gpio_dt_spec motor = GPIO_DT_SPEC_GET_OR(DT_NODELABEL(motor_pin), gpios, {0});

static struct k_work_delayable motor_off_work;

static void motor_off_work_handler(struct k_work *work)
{
    gpio_pin_set_dt(&motor, 0);
}

static int cmd_motor_on(const struct shell *shell, size_t argc, char **argv)
{
    shell_print(shell, "motor on\n");
    gpio_pin_configure_dt(&motor, GPIO_OUTPUT);
    gpio_pin_set_dt(&motor, 1);

    // schedule the delayable work to turn off motor after 100ms
    k_work_schedule(&motor_off_work, K_MSEC(100));

    return 0;
}

static int cmd_motor_off(const struct shell *shell, size_t argc, char **argv)
{
    shell_print(shell, "motor off\n");
    gpio_pin_configure_dt(&motor, GPIO_OUTPUT);
    gpio_pin_set_dt(&motor, 0);

    // remove the delayable work if it is scheduled
    k_work_cancel_delayable(&motor_off_work);

    return 0;
}

static int motor_init(void)
{
    k_work_init_delayable(&motor_off_work, motor_off_work_handler);
    return 0;
}

SHELL_STATIC_SUBCMD_SET_CREATE(sub_motor_cmds,
                               SHELL_CMD_ARG(on, NULL, "Turn on motor", cmd_motor_on, 1, 0),
                               SHELL_CMD_ARG(off, NULL, "Turn off motor", cmd_motor_off, 1, 0),
                               SHELL_SUBCMD_SET_END);

SHELL_CMD_REGISTER(motor, &sub_motor_cmds, "motor", NULL);

SYS_INIT(motor_init, APPLICATION, CONFIG_APPLICATION_INIT_PRIORITY);
```
